/dts-v1/;
/plugin/;

/ {
    compatible = "brcm,bcm2708";

    fragment@0 {
        target = <&i2c1>;
        __overlay__ {
            #address-cells = <1>;
            #size-cells = <0>;
            status = "okay";

            cr14: cr14{
                compatible = "stm,cr14";
                reg = <0x50>;
            };
        };
    };
};
